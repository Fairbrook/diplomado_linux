// SPDX-License-Identifier: GPL-2.0-only
/dts-v1/;
/plugin/;

#include <dt-bindings/pinctrl/am33xx.h>


&am33xx_pinmux {
    i2c1_pins: pinmux_i2c1_pins {
        pinctrl-single,pins = <
            AM33XX_PADCONF(AM335X_PIN_SPI0_D1, PIN_INPUT_PULLUP, MUX_MODE2) /* spi0_d1.12c1_sda */
            AM33XX_PADCONF(AM335X_PIN_SPI0_CS0, PIN_INPUT_PULLUP, MUX_MODE2) /* spi0_cs0.12c1_scl */
        >;
    };
};

&i2c1 {
    pinctrl-names = "default";
    pinctrl-0 = <&i2c1_pins>;

	status = "okay";
    // Frecuency supported from documentation
	clock-frequency = <100000>;

    externalrtc: rtc@68 {
        compatible = "kamv,rtc";
        // Device address from DS32 documentation
        reg = <0x68>;
    };
};
